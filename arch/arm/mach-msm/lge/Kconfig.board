## arch/arm/mach-msm/lge/Kconfig.board
```kconfig
#
# Inlcude the specific Kconfig file for LGE board
#

# FX1(FX1E/FX1A/FX1T/FX1S/FX1V/FX1SU/FX1SK)
source "arch/arm/mach-msm/lge/fx1/Kconfig"
```

## arch/arm/mach-msm/lge/fx1/Kconfig
```kconfig
config BOARD_HEADER_FILE
	string "LGE board specific header file name"
	default ""

config MACH_MSM8960_FX1
	depends on ARCH_MSM8960
	select MACH_LGE
	bool "MSM8960 FX1"
	help
	  Support for the LGE MSM8960 FX1 device.

choice
	depends on MACH_MSM8960_FX1
	prompt "FX1 Board Selection"
	default MACH_MSM8960_FX1SU
          
config MACH_MSM8960_FX1SU
        bool "MSM8960 FX1SU"
        help
          Support for the LGE MSM8960 FX1SU device.

endchoice
```

## drivers/nfc/Kconfig
```kconfig
#
# Near Field Communication (NFC) devices
#

menuconfig NFC_DEVICES
	bool "Near Field Communication (NFC) devices"
	default n
	---help---
	  You'll have to say Y if your computer contains an NFC device that
	  you want to use under Linux.

	  You can say N here if you don't have any Near Field Communication
	  devices connected to your computer.

if NFC_DEVICES

config LGE_NFC
	bool "NFC Device Enabled for LGE"
	default n

config LGE_NFC_PN544_C3
	bool "PN544 C3 NFC driver"
	depends on I2C
	select CRC_CCITT
	default n
	---help---
	  Say yes if you want PN544 Near Field Communication driver.
	  This is for i2c connected version. If unsure, say N here.

	  To compile this driver as a module, choose m here. The module will
	  be called pn544.

config LGE_NFC_PRESTANDBY
	bool "NFC STANBY MODE"
	default n
	---help---
	  Say yes if you want to change a power state of pn544 to stanby mode in Kernel.
	  If unsure, say N here.

config LGE_NFC_MULTICORE_FASTBOOT
	bool "NFC MultiThread"
	default n
	---help---
	  Say yes if multi thread is applied for pre-standby.
	  If unsure, say N here.

config LGE_NFC_HW_QCT_MSM8960
	bool "Qualcom APQ8960 Chipset"
	default n

endif # NFC_DEVICES
```
